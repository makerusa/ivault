/dts-v1/;
/plugin/;

/*
 * OPTIONAL last-resort USB fix for RK3576 boards (e.g. Seeed reComputer RK3576).
 *
 * You very likely DO NOT need this. The usual reason a host can't see the Relay
 * drive on these boards is the vendor `usbdevice` service claiming the USB
 * controller with its own gadget — which the installer already neutralizes. A
 * clean install presents the drive with no overlay.
 *
 * Only apply this if, after that, a host still can't mount the drive AND dmesg
 * shows a persistent "dwc3 ...: device reset / device disconnect" loop that
 * points to a genuinely flaky SuperSpeed link (marginal cable, specific host).
 * It pins the OTG controller to USB 2.0 (high-speed, 480 Mbps) so no SuperSpeed
 * link is attempted — plenty for USB mass storage.
 *
 * IMPORTANT: it deliberately does NOT set dr_mode. On this board, forcing
 * dr_mode = "peripheral" disables Type-C cable/VBUS detection, so the port
 * stops noticing when a host is plugged in. Leave dr_mode at its default (otg).
 *
 * Install (Armbian):
 *   sudo armbian-add-overlay scripts/overlays/rk3576-usb-highspeed.dts
 *   sudo reboot
 *
 * Verify after reboot:
 *   tr -d '\0' < /sys/firmware/devicetree/base/usb@23000000/maximum-speed
 *   # -> high-speed
 *
 * Note: the target node path (/usb@23000000) is specific to the RK3576.
 * On other boards, find it with:
 *   readlink -f /sys/class/udc/*/device/of_node
 */

/ {
    fragment@0 {
        target-path = "/usb@23000000";
        __overlay__ {
            maximum-speed = "high-speed";
        };
    };
};
